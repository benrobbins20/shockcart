VERSION ""

NS_ :

BS_:

BU_: MasterNode MUT_FlowMeterNode

BO_ 496 ffm_FlowRate: 8 MUT_FlowMeterNode
 SG_ fr_ffm_FlowRateVolume : 0|32@1- (1,0) [0|0] "gal/min"  MUT_FlowMeterNode,MasterNode
 SG_ fr_ffm_FlowRateMass : 32|32@1- (1,0) [0|0] "lb/min"  MUT_FlowMeterNode,MasterNode

BO_ 752 ffm_Temperature: 8 MUT_FlowMeterNode
 SG_ tmp_ffm_RawFrequency : 0|32@1- (1,0) [0|0] "Hz"  MUT_FlowMeterNode,MasterNode
 SG_ tmp_ffm_Temperature : 32|32@1- (1,0) [0|0] "°F"  MUT_FlowMeterNode,MasterNode

BO_ 1520 ffm_SDO_Tx: 8 MUT_FlowMeterNode

BO_ 1648 ffm_SDO_Rx: 8 MasterNode
 SG_ sdor_ffm_CCS M : 5|3@1+ (1,0) [0|0] ""  MasterNode,MUT_FlowMeterNode

BO_ 1904 ffm_HeartBeat: 1 MUT_FlowMeterNode
 SG_ hb_ffm_State : 0|7@1+ (1,0) [0|0] ""  MUT_FlowMeterNode,MasterNode

CM_ BU_ MasterNode "System Controller";
CM_ BU_ MUT_FlowMeterNode "MUT Flow Meter";
SIG_VALTYPE_ 496 fr_ffm_FlowRateVolume : 1;
SIG_VALTYPE_ 496 fr_ffm_FlowRateMass : 1;
SIG_VALTYPE_ 752 tmp_ffm_RawFrequency : 1;
SIG_VALTYPE_ 752 tmp_ffm_Temperature : 1;
